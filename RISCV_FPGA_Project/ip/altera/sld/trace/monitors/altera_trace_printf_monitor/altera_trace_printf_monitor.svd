# altera_trace_printf_monitor register map
Registers are write-only, no defined reset value unless marked. A register's access mark holds for its fields unless they carry their own. Offsets are from the block's base; lines under a group give offsets from that group; [hi:lo] are bit positions; {n}, {i} and the like mark numbered series; 'fields as' and 'values as' point back to an identical list; <NAME> marks a mode.

## Memory map
0x00000000 altera_trace_printf_monitor size 0x20

## altera_trace_printf_monitor
Base 0x00000000
0x00 SEND 16-bit
0x04 USER0
0x08 USER1
